## conf/machine/et8500.conf
```bitbake
#@TYPE: Machine
#@NAME: et8500
#@DESCRIPTION: Machine configuration for the et8500

SOC_FAMILY = "bcm7241"
CHIPSET = "bcm7241"

BRAND_OEM = "xtrend"
MACHINE_BRAND = "Xtrend"
MACHINE_NAME = "ET8500"

KERNEL_FILE = "kernel.bin"
ROOTFS_FILE = "rootfs.bin"
MTD_KERNEL = "mtd1"
MTD_ROOTFS = "mtd2"

MACHINE_FEATURES += " dvb-c et-nextv-blindscan-dvbc textlcd ci fanctrl blindscan-dvbc skins1080 smallflash HDMI RCA"
DISTRO_FEATURES_remove = "x11 wayland directfb"

MKUBIFS_ARGS = "-m 2048 -e 126976 -c 8192"
UBINIZE_ARGS = "-m 2048 -p 128KiB"

PREFERRED_VERSION_linux-et-nextv = "4.4.8"
require conf/machine/include/et-nextv-mipsel.inc
```
